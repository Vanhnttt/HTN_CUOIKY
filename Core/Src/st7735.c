#include "st7735.h"
#include "spi.h"

#define LCD_CS_L()    HAL_GPIO_WritePin(GPIOB, GPIO_PIN_10, GPIO_PIN_RESET)
#define LCD_CS_H()    HAL_GPIO_WritePin(GPIOB, GPIO_PIN_10, GPIO_PIN_SET)
#define LCD_DC_CMD()  HAL_GPIO_WritePin(GPIOB, GPIO_PIN_0,  GPIO_PIN_RESET)
#define LCD_DC_DATA() HAL_GPIO_WritePin(GPIOB, GPIO_PIN_0,  GPIO_PIN_SET)
#define LCD_RST_L()   HAL_GPIO_WritePin(GPIOB, GPIO_PIN_1,  GPIO_PIN_RESET)
#define LCD_RST_H()   HAL_GPIO_WritePin(GPIOB, GPIO_PIN_1,  GPIO_PIN_SET)

#define FONT_FIRST 32
#define FONT_LAST  122
#define FONT_W     5
#define FONT_H     7
#define FONT_GAP   1

static const uint8_t font5x7[][5] = {
    {0x00,0x00,0x00,0x00,0x00}, {0x00,0x00,0x5F,0x00,0x00}, {0x00,0x07,0x00,0x07,0x00},
    {0x14,0x7F,0x14,0x7F,0x14}, {0x24,0x2A,0x7F,0x2A,0x12}, {0x23,0x13,0x08,0x64,0x62},
    {0x36,0x49,0x55,0x22,0x50}, {0x00,0x05,0x03,0x00,0x00}, {0x00,0x1C,0x22,0x41,0x00},
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    {0x44,0x64,0x54,0x4C,0x44}
};

static void lcd_cmd(uint8_t c)
{
    LCD_CS_L(); LCD_DC_CMD();
    HAL_SPI_Transmit(&hspi1, &c, 1, 10);
    LCD_CS_H();
}

static void lcd_data_raw(const uint8_t *d, uint16_t n)
{
    LCD_CS_L(); LCD_DC_DATA();
    HAL_SPI_Transmit(&hspi1, (uint8_t *)d, n, 200);
    LCD_CS_H();
}

static void lcd_cmd_data(uint8_t c, const uint8_t *d, uint8_t n)
{
    lcd_cmd(c);
    if (n) lcd_data_raw(d, n);
}

void ST7735_SetWindow(uint16_t x0, uint16_t y0, uint16_t x1, uint16_t y1)
{
    uint8_t b[4];
    x0 += LCD_XOFF; x1 += LCD_XOFF;
    y0 += LCD_YOFF; y1 += LCD_YOFF;
    b[0]=x0>>8; b[1]=x0; b[2]=x1>>8; b[3]=x1;
    lcd_cmd_data(0x2A, b, 4);
    b[0]=y0>>8; b[1]=y0; b[2]=y1>>8; b[3]=y1;
    lcd_cmd_data(0x2B, b, 4);
    lcd_cmd(0x2C);
}

void ST7735_WriteData(const uint8_t *d, uint16_t n)
{
    lcd_data_raw(d, n);
}

void ST7735_Init(void)
{
    LCD_CS_H();
    LCD_RST_H(); HAL_Delay(10);
    LCD_RST_L(); HAL_Delay(20);
    LCD_RST_H(); HAL_Delay(120);

    lcd_cmd(0x01); HAL_Delay(150);
    lcd_cmd(0x11); HAL_Delay(150);

    lcd_cmd_data(0xB1,(uint8_t[]){0x01,0x2C,0x2D},3);
    lcd_cmd_data(0xB2,(uint8_t[]){0x01,0x2C,0x2D},3);
    lcd_cmd_data(0xB3,(uint8_t[]){0x01,0x2C,0x2D,0x01,0x2C,0x2D},6);
    lcd_cmd_data(0xB4,(uint8_t[]){0x07},1);
    lcd_cmd_data(0xC0,(uint8_t[]){0xA2,0x02,0x84},3);
    lcd_cmd_data(0xC1,(uint8_t[]){0xC5},1);
    lcd_cmd_data(0xC2,(uint8_t[]){0x0A,0x00},2);
    lcd_cmd_data(0xC3,(uint8_t[]){0x8A,0x2A},2);
    lcd_cmd_data(0xC4,(uint8_t[]){0x8A,0xEE},2);
    lcd_cmd_data(0xC5,(uint8_t[]){0x0E},1);
    lcd_cmd(0x20);
    lcd_cmd_data(0x36,(uint8_t[]){LCD_MADCTL},1);
    lcd_cmd_data(0x3A,(uint8_t[]){0x05},1);
    lcd_cmd_data(0xE0,(uint8_t[]){
        0x02,0x1C,0x07,0x12,0x37,0x32,0x29,0x2D,
        0x29,0x25,0x2B,0x39,0x00,0x01,0x03,0x10},16);
    lcd_cmd_data(0xE1,(uint8_t[]){
        0x03,0x1D,0x07,0x06,0x2E,0x2C,0x29,0x2D,
        0x2E,0x2E,0x37,0x3F,0x00,0x00,0x02,0x10},16);
    lcd_cmd(0x13); HAL_Delay(10);
    lcd_cmd(0x29); HAL_Delay(100);
}

void ST7735_Clear(uint16_t color)
{
    uint16_t line[LCD_W];
    for (int i = 0; i < LCD_W; i++) line[i] = color;
    ST7735_SetWindow(0, 0, LCD_W - 1, LCD_H - 1);
    for (int y = 0; y < LCD_H; y++)
    {
        ST7735_WriteData((uint8_t *)line, LCD_W * 2);
    }
}

uint8_t ST7735_TextHit(int px, int py, int sx, int sy, const char *s)
{
    int row = py - sy;
    if (row < 0 || row >= FONT_H) return 0;

    while (*s)
    {
        int col = px - sx;
        if (col < 0) break;
        if (col < FONT_W)
        {
            uint8_t c = (uint8_t)*s;
            if (c >= FONT_FIRST && c <= FONT_LAST)
                return (font5x7[c - FONT_FIRST][col] >> row) & 1u;
            return 0;
        }
        sx += FONT_W + FONT_GAP;
        s++;
    }
    return 0;
}
